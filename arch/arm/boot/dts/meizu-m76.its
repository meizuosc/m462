## arch/arm/boot/dts/meizu-m76.its
```
/*
 * U-boot uImage source file with multiple FDT blobs
 *
 * / o image-tree
 *   |- description = "image description"
 *   |- #address-cells = <1>
 *   |
 *   o images
 *   | |
 *   | o fdt@<board version id> {...}
 *   | o fdt@<board version id> {...}
 *   | ...
 */

/dts-v1/;

/ {
	description = "MEIZU M76 FDT blobs";
	#address-cells = <1>;

	images {
		fdt@0 {
			description = "m76-fdt";
			data = /incbin/("./exynos5430-m76-id01.dtb");
			type = "flat_dt";
			arch = "arm";
			compression = "none";
			hash@1 {
				algo = "sha1";
			};
		};
		fdt@1 {
			description = "m76-fdt";
			data = /incbin/("./exynos5430-m76-id01.dtb");
			type = "flat_dt";
			arch = "arm";
			compression = "none";
			hash@1 {
				algo = "sha1";
			};
		};
		fdt@2 {
			description = "m76-fdt";
			data = /incbin/("./exynos5430-m76-id23.dtb");
			type = "flat_dt";
			arch = "arm";
			compression = "none";
			hash@1 {
				algo = "sha1";
			};
		};
		fdt@3 {
			description = "m76-fdt";
			data = /incbin/("./exynos5430-m76-id23.dtb");
			type = "flat_dt";
			arch = "arm";
			compression = "none";
			hash@1 {
				algo = "sha1";
			};
		};

	};
};
```

## drivers/cpufreq/Kconfig.interactive
```kconfig
#
# ARM CPU Frequency scaling drivers
#

config PRE_HISPEED
	bool "Pre Hispeed"
	help
	  This provide with the pre-hispeed to bump to

	  If in doubt, say N.

config DOWN_DELAY
	bool "Delay for scale down"
	help
	  This provide with the tunable parameter for delay time of scaling down

	  If in doubt, say N.
```

## drivers/modem/Kconfig
```kconfig
#
# Near Field Communication (NFC) devices
#
menuconfig LTE_MODEM
	tristate "Meizu 4G-LTE modem support"
	---help---
	  Meizu 4G-LTE modem device

if LTE_MODEM

config NEZHA_HSIC_LINK
	tristate "Marvell nezha modem hsic serial driver"
	depends on USB_SERIAL && USB_EHCI_S5P
	help
	  This enables the NEZHA modem CDC-ACM serial driver. Select this if
	  you make sure PXA1802 NEZHA modem connected to M76 board with HSIC.

	  If unsure, say N.

config NEZHA_HSIC_LINK_PM
	tristate "PM with GPIOs for HSIC USB autosuspend"
	depends on NEZHA_HSIC_LINK
	help
	  This enables HSIC-USB autosuspend and resume driver between s5p-ehci
	  and nezha modem. Make sure usb states(L0/L2/L3) and GPIOs.

	  If unsure, say N.

config NEZHA_WUKONG_LOAD
	tristate "nezha modem firmware download driver"
	depends on NEZHA_HSIC_LINK
	help
	  This adds nezha modem firmware download driver for flashless case
	  PXA1802.

	  If unsure, say N.

config TTY_MUX_TS0710
	tristate "TS07.10 tty mux driver"
	depends on NEZHA_HSIC_LINK
	help
	  This enables tty mux driver for nezha hsic serial device by ldisc.
	  The mux ldisc driver is followed by 3GPP TS07.10.

	  If unsure, say N.

config NEZHA_AUDIO_STUB
	tristate "nezha audio control client driver"
	depends on NEZHA_HSIC_LINK
	help
	  This adds audio stub client driver to connect modem audio server.

	  If unsure, say N.

config NEZHA_NZNET
	tristate "nezha net ldisc driver"
	depends on NEZHA_HSIC_LINK
	help
	  This adds net interface ldisc driver for nezha modem.

	  If unsure, say N.

config NEZHA_GADGET_LDISC
	tristate "nezha gadget ldsic driver"
	depends on NEZHA_HSIC_LINK
	help
	  This adds gadget ldisc channel for marvell_modem and marvell_diag
	  gadget driver for modem tracelog.

	  If unsure, say N.

endif
```

## drivers/video/exynos/panels/Kconfig
```kconfig
config DECON_LCD
	depends on EXYNOS_DECON
	bool "Select LCD panel driver"

config DECON_LCD_S6E8AA0
	depends on DECON_LCD && DECON_MIPI_DSI
	tristate "S6E8AA0 AMOLED HD LCD driver(800 x 1280)"

config DECON_LCD_S6E3FA0
	depends on DECON_LCD && DECON_MIPI_DSI
	tristate "S6E3FA0 AMOLED FULL HD LCD driver(1080 x 1920)"

config DECON_LCD_M6X
	depends on DECON_LCD && DECON_MIPI_DSI
	tristate "compatible m6x FULL HD LCD driver(1080 x 1800)"

config DECON_LCD_M7X
	select DECON_MIC
	depends on DECON_LCD && DECON_MIPI_DSI
	tristate "m7x WQHD LCD driver(1536 x 2560)"
```
